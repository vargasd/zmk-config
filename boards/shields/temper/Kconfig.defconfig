## boards/shields/temper/Kconfig.defconfig
```kconfig
if SHIELD_MY_KEYBOARD_DONGLE

config ZMK_KEYBOARD_NAME
    default "Temper"

config ZMK_SPLIT_ROLE_CENTRAL
    default y

config ZMK_SPLIT
    default y

config ZMK_SPLIT_BLE_CENTRAL_PERIPHERALS
    default 2

endif

if SHIELD_TEMPER_LEFT

config ZMK_KEYBOARD_NAME
    default "Temper"

config ZMK_SPLIT_ROLE_CENTRAL
    default y

endif

if SHIELD_TEMPER_LEFT || SHIELD_TEMPER_RIGHT

config ZMK_SPLIT
    default y
endif
```

## boards/shields/temper/Kconfig.shield
```kconfig
# Copyright (c) 2020 Pete Johanson
# SPDX-License-Identifier: MIT

# No whitespace after the comma or in the keyboard name!
config SHIELD_TEMPER_DONGLE
    def_bool $(shields_list_contains,temper_dongle)

config SHIELD_TEMPER_LEFT
    def_bool $(shields_list_contains,temper_left)

config SHIELD_TEMPER_RIGHT
    def_bool $(shields_list_contains,temper_right)
```
